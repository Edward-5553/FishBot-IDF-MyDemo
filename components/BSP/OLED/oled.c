/**
 * @brief OLED (SSD1306, I2C 0x3C) - IDF v4 旧代码的 v5 适配移植版
 *        - 采用项目现有 I2C 总线封装 myi2c.h（IDF v5 的 i2c_master_bus_* APIs）
 *        - 保留原始 API：oled_init / oled_clear / oled_setxy / oled_ascii / oled_ascii8 / oled_show_ascii_auto_line
 *        - 字体：沿用 6x8 ASCII（本文件中的 ascii[][]），8x16 ASCII 使用 oledfonts.h 的 asc2_1608
 */
#include "oled.h"
#include "myi2c.h"
#include "oledfonts.h"
#include "driver/i2c_master.h"
#include "esp_log.h"
#include <string.h>

#define FISHBOT_MODLUE "OLED"
#define OLED_MAX_LINES 7         /* 页 0..7，可显示 8 行；从 1 开始则最多 7 行 */
#define OLED_START_LINE 1

/* SSD1306 I2C 控制字节 */
#define OLED_CONTROL_CMD   0x00  /* 发送命令 */
#define OLED_CONTROL_DATA  0x40  /* 发送数据 */

#define OLED_I2C_TIMEOUT_MS 1000

static uint8_t last_line_ = 2;
static const char *TAG = "OLED_TMP";

/* I2C 设备句柄（在 myiic_init() 创建的 bus_handle 上添加设备）*/
static i2c_master_dev_handle_t s_oled_dev = NULL;

/* 6x8 ASCII（与原 v4 代码一致） */
static const uint8_t ascii[95][6] = {
    {0x00, 0x00, 0x00, 0x00, 0x00, 0x00},  // sp
    {0x00, 0x00, 0x00, 0x2f, 0x00, 0x00},  // !
    {0x00, 0x00, 0x07, 0x00, 0x07, 0x00},  // "
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    {0x14, 0x14, 0x14, 0x14, 0x14, 0x14},  // horiz lines
};

/* --- 基础 I2C 发送 --- */
static inline esp_err_t oled_tx_ctrl_data(uint8_t ctrl, const uint8_t *data, size_t len)
{
    if (!s_oled_dev) return ESP_ERR_INVALID_STATE;
    uint8_t buf[1 + 128];
    if (len > 128) return ESP_ERR_INVALID_ARG;
    buf[0] = ctrl;
    memcpy(&buf[1], data, len);
    return i2c_master_transmit(s_oled_dev, buf, 1 + len, OLED_I2C_TIMEOUT_MS);
}

static inline esp_err_t oled_send_cmd(uint8_t cmd)
{
    return oled_tx_ctrl_data(OLED_CONTROL_CMD, &cmd, 1);
}

static inline esp_err_t oled_send_cmds(const uint8_t *cmds, size_t n)
{
    for (size_t i = 0; i < n; ++i) {
        esp_err_t err = oled_send_cmd(cmds[i]);
        if (err != ESP_OK) return err;
    }
    return ESP_OK;
}

static inline esp_err_t oled_send_data(const uint8_t *data, size_t len)
{
    return oled_tx_ctrl_data(OLED_CONTROL_DATA, data, len);
}

static inline void oled_set_page_col(uint8_t page, uint8_t col)
{
    oled_send_cmd(0xB0 | (page & 0x07));
    oled_send_cmd(0x00 | (col & 0x0F));
    oled_send_cmd(0x10 | (col >> 4));
}

/* --- 对外 API --- */
bool oled_init(void)
{
    if (bus_handle == NULL) {
        ESP_LOGE(TAG, "I2C 总线未初始化，请先调用 myiic_init()");
        return false;
    }

    if (s_oled_dev) {
        i2c_master_bus_rm_device(s_oled_dev);
        s_oled_dev = NULL;
    }

    i2c_device_config_t dev_cfg = {
        .dev_addr_length = I2C_ADDR_BIT_LEN_7,
        .device_address = OLED_ADDR,
        .scl_speed_hz = IIC_SPEED_CLK,
    };
    esp_err_t err = i2c_master_bus_add_device(bus_handle, &dev_cfg, &s_oled_dev);
    if (err != ESP_OK) {
        ESP_LOGE(TAG, "添加 OLED 设备失败: %s", esp_err_to_name(err));
        return false;
    }

    /* 使用原始 v4 代码的初始化序列（逐条命令发送） */
    uint8_t cmd_data[] = {0xae, 0x20, 0x10, 0xb0, 0xc8, 0x00, 0x10,
                          0x40, 0x81, 0x7f, 0xa1, 0xa6, 0xa8, 0x3f,
                          0xa4, 0xd3, 0x00, 0xd5, 0xf0, 0xd9, 0x22,
                          0xda, 0x12, 0xdb, 0x20, 0x8d, 0x14, 0xaf};
    err = oled_send_cmds(cmd_data, sizeof(cmd_data));
    if (err != ESP_OK) {
        ESP_LOGE(TAG, "OLED 初始化命令发送失败: %s", esp_err_to_name(err));
        return false;
    }

    oled_clear();
    oled_ascii8(0, 0, "        FISHBOT     ");
    oled_ascii8(0, 1, "Ver :V1.0.0.220820  ");
    ESP_LOGI(FISHBOT_MODLUE, "init success!");
    return true;
}

void oled_clear(void)
{
    uint8_t zeros[128];
    memset(zeros, 0x00, sizeof(zeros));
    for (int page = 0; page < 8; ++page) {
        oled_set_page_col(page, 0);
        oled_send_data(zeros, sizeof(zeros));
    }
}

void oled_setxy(uint8_t x, uint8_t y)
{
    if (y > 7) y = 7;
    if (x > 127) x = 127;
    oled_set_page_col(y, x);
}

bool oled_show_ascii_auto_line(char *str)
{
    if (!str) return false;
    size_t len = strlen(str);
    if (len > 21) {
        ESP_LOGW(FISHBOT_MODLUE, "len can't >21 char!");
        return false;
    }
    /* 清空本页并写入 */
    uint8_t blanks[128];
    memset(blanks, 0x00, sizeof(blanks));
    uint8_t page = last_line_;
    if (page > 7) page = OLED_START_LINE; /* 防越界 */
    oled_set_page_col(page, 0);
    oled_send_data(blanks, sizeof(blanks));
    oled_ascii8(0, page, str);

    last_line_ = (uint8_t)((page + 1) > OLED_MAX_LINES ? OLED_START_LINE : (page + 1));
    return true;
}

void oled_ascii8(uint8_t x, uint8_t y, char *str)
{
    if (!str) return;
    if (y > 7) y = 7;
    if (x > 127) x = 127;

    oled_set_page_col(y, x);
    int col = x;
    for (int i = 0; i < 21 && str[i] != 0; ++i) {
        uint8_t ch = (uint8_t)str[i];
        if (ch < 32 || ch > 126) ch = ' ';
        const uint8_t *glyph = ascii[ch - 32];
        if (col + 6 > 128) break; /* 当前行剩余不足 */
        oled_send_data(glyph, 6);
        col += 6;
    }
}

void oled_ascii(uint8_t x, uint8_t y, char *str)
{
    if (!str) return;
    /* 8x16 字符，每字宽 8 列，高跨两页（y 与 y+1） */
    uint8_t page_top = (y > 6) ? 6 : y;
    uint8_t col = (x > 127) ? 127 : x;

    for (int i = 0; i < 16 && str[i] != 0; ++i) {
        uint8_t ch = (uint8_t)str[i];
        if (ch < 32 || ch > 126) ch = ' ';
        const uint8_t *glyph = asc2_1608[ch - 32];
        if (col + 8 > 128) break; /* 当前行剩余不足 */

        /* 上半部分（8 字节） */
        oled_set_page_col(page_top, col);
        oled_send_data(glyph + 0, 8);

        /* 下半部分（8 字节） */
        oled_set_page_col(page_top + 1, col);
        oled_send_data(glyph + 8, 8);

        col += 8;
    }
}
